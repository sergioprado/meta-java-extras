## conf/layer.conf
```bitbake
# We have a conf and classes directory, add to BBPATH
BBPATH .= ":${LAYERDIR}"

# We have recipes-* directories, add to BBFILES
BBFILES += "${LAYERDIR}/recipes-*/*/*.bb \
	${LAYERDIR}/recipes-*/*/*.bbappend"

BBFILE_COLLECTIONS += "java-extras"
BBFILE_PATTERN_java-extras = "^${LAYERDIR}/"
BBFILE_PRIORITY_java-extras = "6"

LAYERDEPENDS_java-extras = "meta-java"
```
